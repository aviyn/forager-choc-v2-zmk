#include "forager.dtsi"

/ {
   kscan0: kscan_0 {
      compatible = "zmk,kscan-gpio-matrix";
      diode-direction = "col2row";
      wakeup-source;

      col-gpios
      = <&gpio0 2 GPIO_ACTIVE_HIGH>
      , <&gpio0 3 GPIO_ACTIVE_HIGH>
      , <&gpio0 28 GPIO_ACTIVE_HIGH>
      , <&gpio0 29 GPIO_ACTIVE_HIGH>
      , <&gpio0 4 GPIO_ACTIVE_HIGH>
      ;

      row-gpios
      = <&gpio1 11 (GPIO_ACTIVE_HIGH | GPIO_PULL_DOWN)>
      , <&gpio1 13 (GPIO_ACTIVE_HIGH | GPIO_PULL_DOWN)>
      , <&gpio1 12 (GPIO_ACTIVE_HIGH | GPIO_PULL_DOWN)>
      , <&gpio1 14 (GPIO_ACTIVE_HIGH | GPIO_PULL_DOWN)>
      ;
   };
};
/* LED1 (first in the chain) is the outer one, nearest the XIAO */
&status_leds {
   enable-gpios = <&gpio1 15 GPIO_ACTIVE_LOW>; /* D10, P-FET gate */
   led-order = <0 1 2>;
};
