## config/west.yml
```yaml
manifest:
  remotes:
    - name: zmkfirmware
      url-base: https://github.com/zmkfirmware
    - name: aviyn
      url-base: https://github.com/aviyn
  projects:
    - name: zmk
      remote: zmkfirmware
      revision: main
      clone-depth: 1
      import:
        file: app/west.yml
    - name: zmk-ledstrip-status
      remote: aviyn
      revision: main
      clone-depth: 1
  self:
    path: config
```
